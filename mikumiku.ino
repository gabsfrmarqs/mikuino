#include <LiquidCrystal.h>

// Define the connection pins between the Arduino and the LCD Display
const int rs = 12, en = 11, d4 = 5, d5 = 4, d6 = 3, d7 = 2;
LiquidCrystal lcd(rs, en, d4, d5, d6, d7);

int tonePin = 8; // The buzzer is connected to pin 8 of the Arduino

// Define a structure to hold note information
typedef struct {
  int frequency;
  int duration;
} Note;

// Array of notes for the melody
Note melody[] = {
  { 277, 210 },
  { 349, 210 },
  { 415, 210 },
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  { 554, 1064 },
};
const int melodyLength = sizeof(melody) / sizeof(melody[0]); // Calculate melody length
int currentNote = 0;

// Protothread variables
unsigned long lastMillisMidi = 0; 
unsigned long lastMillisScreen = 0;

// Function to play a single note
void playNote(int frequency, unsigned long duration) {
  tone(tonePin, frequency);
  delay(duration); // Use delay for simplicity
  noTone(tonePin);
}

// Function to handle the melody playback
void playMelody() {
  if (currentNote < melodyLength) {
    playNote(melody[currentNote].frequency, melody[currentNote].duration);
    currentNote++;
  } else {
    currentNote = 0; 
  }
}

// Function to update the LCD screen
// idk why this didnt work with switch case
int i = 0;
void updateScreen() {
  lcd.setCursor(0, 0);
  if (i == 0){
    lcd.print("miku            ");
  }
  else if (i == 1){
    lcd.print("miku miku       ");
  } else if (i == 2){
    lcd.setCursor(0,1);
    lcd.print("ooo             ");
  }
  else if (i == 3){
    lcd.setCursor(0,1);
    lcd.print("ooo eee         ");
  }
  else if (i == 4){
    lcd.setCursor(0,1);
    lcd.print("ooo eee ooo     ");
  }
  else if (i == 5){
    lcd.clear();
    lcd.setCursor(0,0);
    lcd.print("miku            ");
  }
  i++;
  if (i == 6){
    i = 0;
  }
 // Increment the counter after the if-else chain
}

void setup() {
  pinMode(tonePin, OUTPUT);
  lcd.begin(16, 2);
  lcd.setCursor(0, 0);
  lcd.print("miku miku");
  lcd.setCursor(0, 1);
  lcd.print("ooo eee ooo");
  Serial.begin(9600);
}

void loop() {
  playMelody();
  updateScreen();
  delay(25); // Add a slight delay between updates
}